// SPDX-License-Identifier: GPL-2.0+ OR MIT
/dts-v1/;
/plugin/;

/* Only on phandled N71 Samsung RAM Linux with original port1 block active.
 * A unique, opt-in microlease experimental device, no MMIO/GPIO/PHY/DART.
 * THREE PMGR specifiers deliberately prevent the platform core from
 * attaching and powering a single PM domain before the gated driver probe.
 * The special driver will target ONLY the pcie_link1 WLAN child and kernel-managed parent.
 * NEVER provide any real Apple PCIe host compatible here.
 */
/ {
    fragment@0 {
        target-path = "/soc";
        __overlay__ {
            n71-port1-link1-microlease {
                compatible = "research,n71-s8000-pcie-link1-microlease";
                status = "okay";
                research,owner-supervised-link1-only;
                power-domains = <0x3a>, <0x3b>, <0x3c>, <0x2c>;
                power-domain-names = "ref", "aux", "link1", "root";
            };
        };
    };
};
